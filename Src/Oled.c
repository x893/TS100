#include <stdio.h>
#include <string.h>
#include "APP_Version.h"
#include "Oled.h"
#include "Bios.h"
#include "I2C.h"
#include "HARDWARE.h"
#include "DISK.h"
#include "UI.h"
#include "CTRL.h"

#ifdef MFTSEEED
uint8_t Seeed[] = {
	0x00,0x00,0x00,0x00,0x00,0x00,0x00,0xC0,0x80,0x00,0x00,0xC0,0xF8,0x38,0x04,0x00,
	0x04,0x38,0xF8,0xC0,0x00,0x00,0x80,0xC0,0x00,0x00,0x00,0x00,0x00,0x00,0xE0,0x30,
	0x10,0x10,0x10,0x10,0x10,0x20,0x00,0x00,0x80,0xC0,0x60,0x30,0x10,0x10,0x10,0x30,
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	0x10,0x20,0x20,0x20,0x20,0x10,0x18,0x7F,0x00,0x00,0x00,0x00,0x00,0x00,0x00,0x00,
};
#else
uint8_t Mini[] = {
	0x00,0x00,0x00,0x00,0x00,0x00,0x00,0x00,0x00,0x00,0x00,0x00,0x00,0x00,0x00,0x00,
	0x00,0x00,0x00,0x00,0x00,0x00,0x00,0x00,0x80,0xC0,0xE0,0xF0,0xF8,0xFC,0xFE,0xFE,
	0xFC,0xF8,0xF0,0xE0,0xC0,0x80,0xC0,0xE0,0xF0,0xF8,0xFC,0xFE,0xFE,0xFE,0xFC,0x78,
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	0x00,0x00,0x00,0x00,0x00,0x00,0x00,0x00,0x00,0x00,0x00,0x00,0x00,0x00,0x00,0x00,
};
#endif

#ifdef SSD1316
uint8_t gOled_param[] = {	// 50
	0x80,0xAE,0x80,0x00,0x80,0x10,0x80,0x40,0x80,0xB0,
	0x80,0x81,0x80,0xFF,0x80,0xA0,0x80,0xA6,0x80,0xA8,
	0x80,0x1F,0x80,0xC8,0x80,0xD3,0x80,0x00,0x80,0xD5,
	0x80,0x80,0x80,0xD9,0x80,0x22,0x80,0xDA,0x80,0x12,
	0x80,0xDB,0x80,0x40,0x80,0x8D,0x80,0x14,0x80,0xAF
};
#else
uint8_t gOled_param[] = {	// 46
	0x80,0xAE,0x80,0xD5,0x80,0x52,0x80,0xA8,0x80,0x0f,
	0x80,0xC0,0x80,0xD3,0x80,0x00,0x80,0x40,0x80,0xA0,
	0x80,0x8D,0x80,0x14,0x80,0xDA,0x80,0x02,0x80,0x81,
	0x80,0x33,0x80,0xD9,0x80,0xF1,0x80,0xDB,0x80,0x30,
	0x80,0xA4,0x80,0XA6,0x80,0xAF
};
#endif

/*******************************************************************************
@@name  Sc_Pt
@@brief Screen saver changes the screen contrast
@@param Co screen contrast parameters
@@return NULL
*******************************************************************************/
void Sc_Pt(uint8_t contrast) // screen protector
{
	uint8_t pt[4] = { 0x80, 0x81, 0x80, contrast };
	I2C_PageWrite(pt, 4, DEVICEADDR_OLED);
}

/*******************************************************************************
@@name  Oled_DisplayOn
@@brief Open the OLED display
@@param NULL
@@return NULL
*******************************************************************************/
const uint8_t OLED_ON[] = { 0x80, 0x8D, 0x80, 0x14, 0x80, 0xAF};
void Oled_DisplayOn(void)
{
	I2C_PageWrite((uint8_t *)OLED_ON, sizeof(OLED_ON), DEVICEADDR_OLED);
}

/*******************************************************************************
@@name  Oled_DisplayOff
@@brief Turn off the OLED display
@@param NULL
@@return NULL
*******************************************************************************/
const uint8_t OLED_OFF[] = { 0x80, 0x8D, 0x80, 0x10, 0x80,0xAE };
void Oled_DisplayOff(void)
{
	I2C_PageWrite((uint8_t *)OLED_OFF, sizeof(OLED_OFF), DEVICEADDR_OLED);
}

/*******************************************************************************
@@name  Data_Command
@@brief The width of the display and the displayed input are passed to the OLED
@@param Wide, ptr library pointer
@@return The next library pointer
*******************************************************************************/
uint8_t * Data_Command(uint16_t len, uint8_t * ptr)
{
	int i;
	uint8_t tx_data[128];

	tx_data[0] = 0x40;
	len += 1;
	for (i = 1; i < len; i++)
		tx_data[i] = *ptr++;
	I2C_PageWrite(tx_data, len, DEVICEADDR_OLED);
	return ptr;
}

/*******************************************************************************
@@name	Set_ShowPos
@@brief	The location where the content is to be displayed
@@param	x: position
		y:(position 0,8,16,24)
@@return NULL
*******************************************************************************/
static uint8_t pos_param[8] = { 0x80, 0xB0, 0x80, 0x21, 0x80, 0x20, 0x80, 0x7F };
void Set_ShowPos(uint8_t x, uint8_t y)
{
	if (device_info.handers == 1)	pos_param[5] = x;
	else							pos_param[5] = x + 32;
	pos_param[1] += y;
	I2C_PageWrite(pos_param, 8, DEVICEADDR_OLED);
}

/*******************************************************************************
@@name	Oled_DrawArea
@@brief Show an area
@@param	x0: starting x
		y0: starting y
		wide: show content width
		high: show content height
		ptr: display the contents of the library pointer
@@return The next library pointer
*******************************************************************************/
uint8_t * Oled_DrawArea(uint8_t x0, uint8_t y0, uint8_t wide, uint8_t high, uint8_t * ptr)
{
	uint8_t m, n, y;

	n = y0 + high;
	if (y0 % 8 == 0)	m = y0 / 8;
	else				m = y0 / 8 + 1;

	if (n % 8 == 0)		y = n / 8;
	else				y = n / 8 + 1;

	for (; m < y; m++)
	{
		Set_ShowPos(x0, m);
		ptr = Data_Command(wide, ptr);
	}
	return ptr;
}

/*******************************************************************************
@@name	Clean_Char
@@brief	Clear the length of the wide position for the screen at k
@@param	Clear the position wide for the clear width
@@return	NULL
*******************************************************************************/
void Clean_Char(uint8_t k, uint8_t wide)
{
	uint8_t i;
	uint8_t tx_data[128];

	memset(tx_data, 0, wide);
	for (i = 0; i < 2; i++)
		Oled_DrawArea(k, i * 8, wide, 8, tx_data);
}

/*******************************************************************************
@@name  Init_Oled
@@brief Initialize LED settings
@@param NULL
@@return NULL
*******************************************************************************/
void Init_Oled(void)
{
	OLED_RST();
	Delay_Ms(2);
	OLED_ACT();
	Delay_Ms(2);

	if (device_info.handers == 1)
	{
		gOled_param[11] = 0xC8;
		gOled_param[19] = 0xA1;
	}
	else
	{
		gOled_param[11] = 0xC0;
		gOled_param[19] = 0xA0;
	}
	I2C_PageWrite((uint8_t *)gOled_param, sizeof(gOled_param), DEVICEADDR_OLED);
}

/*******************************************************************************
@@name  Clear_Screen
@@brief Clear screen
@@param NULL
@@return NULL
*******************************************************************************/
void Clear_Screen(void)
{
	uint8_t tx_data[128];
	int i, wd;

#ifdef SSD1316
	wd = 32;
#else
	wd = 16;
#endif

	memset(tx_data, 0, 128);
	for (i = 0; i < wd / 8; i++)
		Oled_DrawArea(0, i * 8, 128, 8, tx_data);
}

/*******************************************************************************

*******************************************************************************/
void Display_BG(void)
{
	uint8_t i, j, k, m, n, p, ch, Palette = 1;
	uint8_t * bmpfile;
	uint16_t filelen;
	uint16_t * Root_addr = 0;
	uint8_t g_au8TxData[128];
	
	memset(g_au8TxData, 0, 128);

	if ((bmpfile = SearchFile((uint8_t *)"LOGOIN  BMP", &filelen, Root_addr)) != NULL)
	{
		if (bmpfile[0] == 'B' && bmpfile[1] == 'M' )
		{
			if (bmpfile[0x36] == 0xFF && bmpfile[0x37] == 0xFF && bmpfile[0x38] == 0xFF)
				Palette = 0;

			p = 0x1;
			for (i = 15; i >= 8; i--)
			{
				m = 0;
				for (j = 0; j < 12; j++)
				{
					ch = bmpfile[0x3E + i * 12 + j];
					n = 0x80;
					for (k = 0; k < 8; k++)
					{
						if (Palette)
						{
							if (!(ch & n))
								g_au8TxData[m + 1] |= p;
						}
						else
						{
							if ((ch & n))
								g_au8TxData[m + 1] |= p;
						}
						m++;
						n >>= 1;
					}
				}
				p <<= 1;
			}
			Oled_DrawArea(0, 0, 96, 8, g_au8TxData);
			Clear_Watchdog();

			memset(&g_au8TxData[1], 0, 127);
			p = 0x1;
			for (i = 0; i < 8; i++)
			{
				m = 0;
				for (j = 0; j < 12; j++)
				{
					ch = bmpfile[0x3E + (7 - i) * 12 + j];
					n = 0x80;
					for (k = 0; k < 8; k++)
					{
						if (Palette) {
							if (!(ch & n)) g_au8TxData[m + 1] |= p;
						} else {
							if ((ch & n))  g_au8TxData[m + 1] |= p;
						}
						m++;
						n >>= 1;
					}
				}
				p <<= 1;
			}
			Oled_DrawArea(0, 8, 96, 8, g_au8TxData);
			Delay_Ms(1000);
			Clear_Watchdog();
			return;
		}
	}
	else
	{
		uint8_t		*ptr = 0;
#ifdef MFTSEEED
		ptr = (uint8_t *)Seeed;
#else
		ptr = (uint8_t *)Mini;
#endif
		Oled_DrawArea(0, 0, 96, 16, ptr);
		Delay_Ms(1000);

		Clear_Watchdog();
	}
}
